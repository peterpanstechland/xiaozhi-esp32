## main/boards/silicore-lite/sdkconfig.defaults
```kconfig
# LVGL memory optimizations for ESP32-C3
CONFIG_LV_OS_NONE=y
CONFIG_LV_USE_OS=0
CONFIG_LV_USE_CLIB_MALLOC=y
CONFIG_LV_USE_CLIB_STRING=y
CONFIG_LV_USE_CLIB_SPRINTF=y
CONFIG_LV_USE_IMGFONT=y

# Use compressed font to save memory
CONFIG_LV_FONT_FMT_TXT_LARGE=y
CONFIG_LV_USE_FONT_COMPRESSED=y
CONFIG_LV_USE_FONT_PLACEHOLDER=y

# Disable extra widgets to save flash and memory
CONFIG_LV_USE_ANIMIMG=n
CONFIG_LV_USE_CALENDAR=n
CONFIG_LV_USE_CALENDAR_HEADER_ARROW=n
CONFIG_LV_USE_CALENDAR_HEADER_DROPDOWN=n
CONFIG_LV_USE_CHART=n
CONFIG_LV_USE_KEYBOARD=n
CONFIG_LV_USE_LED=n
CONFIG_LV_USE_LIST=n
CONFIG_LV_USE_MENU=n
CONFIG_LV_USE_MSGBOX=n
CONFIG_LV_USE_SPAN=n
CONFIG_LV_USE_SPINBOX=n
CONFIG_LV_USE_SPINNER=n
CONFIG_LV_USE_TABVIEW=n
CONFIG_LV_USE_TILEVIEW=n
CONFIG_LV_USE_WIN=n
CONFIG_LV_BUILD_EXAMPLES=n

# Additional LVGL optimizations
CONFIG_LV_TICK_CUSTOM=y
CONFIG_LV_TICK_CUSTOM_SYS_TIME_EXPR=0
CONFIG_LV_DISP_DEF_REFR_PERIOD=50
CONFIG_LV_INDEV_DEF_READ_PERIOD=50
CONFIG_LV_USE_LARGE_COORD=n

# Reduce memory allocation overhead
CONFIG_LV_MEM_CUSTOM=n
CONFIG_LV_MEM_SIZE_KILOBYTES=32
CONFIG_LV_MEM_POOL_INCLUDE_LARGE_MEM_OBJS=n

# Font optimizations
CONFIG_LV_FONT_MONTSERRAT_8=n
CONFIG_LV_FONT_MONTSERRAT_10=n
CONFIG_LV_FONT_MONTSERRAT_12=n
CONFIG_LV_FONT_MONTSERRAT_14=n
CONFIG_LV_FONT_MONTSERRAT_16=n
CONFIG_LV_FONT_MONTSERRAT_18=n
CONFIG_LV_FONT_MONTSERRAT_20=n
CONFIG_LV_FONT_MONTSERRAT_22=n
CONFIG_LV_FONT_MONTSERRAT_24=n
CONFIG_LV_FONT_MONTSERRAT_26=n
CONFIG_LV_FONT_MONTSERRAT_28=n
CONFIG_LV_FONT_MONTSERRAT_30=n
CONFIG_LV_FONT_MONTSERRAT_32=n
CONFIG_LV_FONT_MONTSERRAT_34=n
CONFIG_LV_FONT_MONTSERRAT_36=n
CONFIG_LV_FONT_MONTSERRAT_38=n
CONFIG_LV_FONT_MONTSERRAT_40=n
CONFIG_LV_FONT_MONTSERRAT_42=n
CONFIG_LV_FONT_MONTSERRAT_44=n
CONFIG_LV_FONT_MONTSERRAT_46=n
CONFIG_LV_FONT_MONTSERRAT_48=n

# Watchdog optimizations
CONFIG_ESP_TASK_WDT_TIMEOUT_S=30
CONFIG_ESP_TASK_WDT_PANIC=n

# LVGL drawing optimizations
CONFIG_LV_DRAW_COMPLEX=n
CONFIG_LV_SHADOW_CACHE_SIZE=0
CONFIG_LV_IMG_CACHE_DEF_SIZE=0

# Optimize memory usage
CONFIG_ESP_MAIN_TASK_STACK_SIZE=8192
CONFIG_MBEDTLS_DYNAMIC_BUFFER=y
CONFIG_MBEDTLS_SSL_KEEP_PEER_CERTIFICATE=n
CONFIG_ESP_WIFI_IRAM_OPT=n
CONFIG_ESP_WIFI_RX_IRAM_OPT=n
CONFIG_ESP_WIFI_DYNAMIC_RX_MGMT_BUFFER=y

# Enable task stats for debugging
CONFIG_FREERTOS_GENERATE_RUN_TIME_STATS=y
CONFIG_FREERTOS_USE_STATS_FORMATTING_FUNCTIONS=y 
```
